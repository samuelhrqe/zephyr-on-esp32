## CMakeLists.txt
```
cmake_minimum_required(VERSION 3.20.0)

set(BOARD esp32_devkitc_wroom/esp32/procpu)

set(BOARD_DIR ${CMAKE_CURRENT_SOURCE_DIR}/boards)
set(DTC_OVERLAY_FILE ${BOARD_DIR}/esp32_devkitc_wroom.overlay)
set(EXTRA_CONF_FILE ${BOARD_DIR}/esp32_devkitc_wroom.conf)
# set(EXTRA_DTC_OVERLAY_FILE ${BOARD_DIR}/esp32_devkitc_wroom.overlay)
# set(CONF_FILE "${BOARD_DIR}/esp32_devkitc_wroom.conf" "${CMAKE_CURRENT_SOURCE_DIR}/prj.conf")

find_package(Zephyr REQUIRED HINTS $ENV{ZEPHYR_BASE})

project(hello_blink)

add_subdirectory(lib/say_hello)

target_sources(app PRIVATE src/main.c)

target_link_libraries(app PRIVATE hello_lib)

message(STATUS "Board: ${BOARD}")
message(STATUS "Devicetree Overlay: ${DTC_OVERLAY_FILE}")
message(STATUS "Extra Config File: ${EXTRA_CONF_FILE}")
```

## prj.conf
```kconfig
CONFIG_PRINTK=y # Required for printk
CONFIG_GPIO=y # Required for GPIO
```

## boards/esp32_devkitc_wroom.conf
```kconfig
CONFIG_ESP32_USE_UNSUPPORTED_REVISION=y # Required for ESP32-D0WDQ6 (revision v1.0)
```

## boards/esp32_devkitc_wroom.overlay
```dts
/ {
	leds {
		compatible = "gpio-leds"; // This is the driver that will be used to control the LED
		blinking_led: blinking_led {  // This is the name of the LED
			gpios = <&gpio0 25 GPIO_ACTIVE_HIGH>; // The GPIO pin that the LED is connected to
			label = "LED_0"; // This is the label that will be used to control the LED
		};
	};
};
```

## src/main.c
```c
#include <zephyr/kernel.h>
#include <zephyr/device.h>
#include <zephyr/drivers/gpio.h>
#include "say_hello.h"

/**
 * @brief DigiKey Class about Zephyr
 * 
 * Integrate the say_hello library into the Zephyr project using CMake.
 * 
 */
static const int32_t sleep_time_ms = 1000; // Sleep time in milliseconds
static const struct gpio_dt_spec led = GPIO_DT_SPEC_GET(DT_NODELABEL(blinking_led), gpios);

int main(void) {
    if (!device_is_ready(led.port)) { // device_is_ready_dt(&led)
        printk("GPIO device is not ready\r\n");
        return 0;
    }

    // int ret = gpio_pin_configure(led.port, led.pin, led.dt_flags);
	int ret = gpio_pin_configure_dt(&led, GPIO_OUTPUT_ACTIVE);
    if (ret != 0) {
        printk("Failed to configure GPIO pin\r\n");
        return ret;
    }

    while (true) {
        say_hello(); // Call the function from say_hello.h
        ret = gpio_pin_toggle_dt(&led);
        if (ret != 0) {
            printk("Failed to set GPIO pin\r\n");
            return ret;
        }
        k_msleep(sleep_time_ms); // Sleep for the specified time
    }
}
```
