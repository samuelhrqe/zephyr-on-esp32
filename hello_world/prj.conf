## CMakeLists.txt
```
cmake_minimum_required(VERSION 3.20.0)

find_package(Zephyr REQUIRED HINTS $ENV{ZEPHYR_BASE})
# find_package(Zephyr)

project(hello_world)

target_sources(app PRIVATE src/main.c)
```

## prj.conf
```kconfig
CONFIG_ESP32_USE_UNSUPPORTED_REVISION=y
CONFIG_PRINTK=y
```

## src/main.c
```c
#include <zephyr/kernel.h>
#include <zephyr/device.h>

int main(void)
{
    while (true) {
        printk("Hello, World!\r\n");
        k_msleep(1000);
    }

    return 0;
}
```
