## kconfig_demo/boards/esp32_devkitc_wroom.conf
```kconfig
CONFIG_ESP32_USE_UNSUPPORTED_REVISION=y # Required for ESP32-D0WDQ6 (revision v1.0)

# Random number generation configuration
CONFIG_STACK_POINTER_RANDOM=0
CONFIG_TEST_RANDOM_GENERATOR=y
CONFIG_TIMER_RANDOM_GENERATOR=y
CONFIG_TEST_CSPRNG_GENERATOR=y
CONFIG_SAY_HELLO=y

# Enable print float using software
# Reference: https://docs.zephyrproject.org/latest/develop/languages/c/picolibc.html#formatted-output
CONFIG_PICOLIBC_IO_FLOAT=y

# Enable the use of the ESP32's hardware floating point unit (hardware acceleration)
# CONFIG_FPU=y
```
